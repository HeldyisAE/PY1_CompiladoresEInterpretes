| ============================================================
| PRUEBA SINTACTICA DIFICIL
| Objetivo: probar recuperacion de errores sintacticos
| ============================================================

| ============================================================
| DECLARACIONES INCORRECTAS
| ============================================================

val int»
val int variable Ͱ»
val int Ͱ 10»
val variable Ͱ 10»
val int variable1 10»
val int variable2 Ͱ»
val float decimal Ͱ 10»
val bool bandera Ͱ»
val string texto Ͱ»
val char letra Ͱ»

| ============================================================
| EXPRESIONES INCOMPLETAS
| ============================================================

val int error1 Ͱ 10 +»
val int error2 Ͱ + 10»
val int error3 Ͱ 10 *»
val int error4 Ͱ * 10»
val int error5 Ͱ 10 pot»
val int error6 Ͱ pot 10»
val int error7 Ͱ є: 10 + 20»
val int error8 Ͱ є: 10 + :э»
val int error9 Ͱ є: :э»
val int error10 Ͱ є: 10 * є: 20 :э»
val int error11 Ͱ є: 10 + 20 :э *»

| ============================================================
| PARENTESIS INCORRECTOS
| ============================================================

val int parentesis1 Ͱ є: 10 + 20 :э :э»
val int parentesis2 Ͱ є: 10 + 20»
val int parentesis3 Ͱ є: 10 + є: 20 + 30 :э»
val int parentesis4 Ͱ є: є: 10 + 20 :э * 30»

| ============================================================
| LLAMADAS INCORRECTAS
| ============================================================

val int llamada1 Ͱ suma є: :э»
val int llamada2 Ͱ suma є: 10 :э»
val int llamada3 Ͱ suma є: 10, :э»
val int llamada4 Ͱ suma є: , 20 :э»
val int llamada5 Ͱ suma є: 10, 20, :э»
val int llamada6 Ͱ suma є: 10 20 :э»
val int llamada7 Ͱ suma є: 10, 20»

| ============================================================
| FUNCIONES INCORRECTAS
| ============================================================

int suma є: int a int b :э ¿:

```
return a + b»
```

:?

int resta є: int a, int b :э ¿:

```
return a - b»
```

:?

int multiplicacion є: int a, :э ¿:

```
return a * 10»
```

:?

| ============================================================
| IF INCORRECTOS
| ============================================================

if ¿:

```
print є: "Error" :э
```

:?

if є: 10 > 5 :э

```
print є: "Error" :э
```

if є: 10 > 5 :э ¿:

```
print є: "Correcto" :э
```

else

```
print є: "Error" :э
```

:?

if є: 10 > 5 :э ¿:

```
print є: "A" :э
```

:? else :э ¿:

```
print є: "B" :э
```

:?

| ============================================================
| WHILE INCORRECTOS
| ============================================================

while є: 10 > 0 :э

```
print є: "Error" :э
```

:?

while є: :э ¿:

```
print є: "Error" :э
```

:?

while ¿: 10 > 0 :э ¿:

```
print є: "Error" :э
```

:?

| ============================================================
| FOR INCORRECTOS
| ============================================================

for є: i Ͱ 0» i < 10 :э ¿:

```
print є: i :э
```

:?

for є: i Ͱ 0»» i < 10» i++ :э ¿:

```
print є: i :э
```

:?

for є: i Ͱ 0» i < 10» :э ¿:

```
print є: i :э
```

:?

| ============================================================
| OPERADORES MAL UBICADOS
| ============================================================

val int operador1 Ͱ 10 + * 20»
val int operador2 Ͱ 10 * + 20»
val int operador3 Ͱ 10 - / 20»
val int operador4 Ͱ 10 pot * 2»
val int operador5 Ͱ 10 + 20 30»
val int operador6 Ͱ 10 20 + 30»

| ============================================================
| RETURN INCORRECTOS
| ============================================================

int pruebaReturn є: int x :э ¿:

```
return»
```

:?

int pruebaReturn2 є: int x :э ¿:

```
return x +»
```

:?

int pruebaReturn3 є: int x :э ¿:

```
return є: x + 10» 
```

:?

| ============================================================
| ESTRUCTURAS MAL ANIDADAS
| ============================================================

void estructura є: :э ¿:

```
if є: 10 > 0 :э ¿:

    while є: 20 > 0 :э ¿:

        for є: i Ͱ 0» i < 10» i++ :э ¿:

            if є: i > 5 :э ¿:

                print є: "Profundo" :э

            :?

        :?

    :?

:?
```

:?

| ============================================================
| OPERACIONES MUY PROFUNDAS
| ============================================================

val int profunda1 Ͱ є: є: 1 + 2 :э * є: 3 + 4 :э»
val int profunda2 Ͱ є: є: є: 1 + 2 :э * 3 :э + 4»
val int profunda3 Ͱ suma є: є: 1 + 2 :э, є: 3 * 4 :э»
val int profunda4 Ͱ suma є: suma є: 1, 2 :э, :э»
val int profunda5 Ͱ є: suma є: 1, 2 :э + 10 :э»

| ============================================================
| BLOQUES MAL CERRADOS
| ============================================================

void bloque1 є: :э ¿:

```
print є: "Bloque 1" :э
```

void bloque2 є: :э ¿:

```
if є: 10 > 0 :э ¿:

    print є: "Bloque 2" :э
```

:?

void bloque3 є: :э ¿:

```
while є: 10 > 0 :э ¿:

    print є: "Bloque 3" :э
```

:?

:?

:?

| ============================================================
| FIN
| ============================================================

print є: "Fin de prueba sintactica" :э
