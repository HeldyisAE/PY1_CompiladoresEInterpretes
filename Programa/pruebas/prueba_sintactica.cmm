
| ============================================================
| PARTE VALIDA
| ============================================================

val int a Ͱ 10»
val int b Ͱ 20»
val int c Ͱ 30»

val float x Ͱ 10.5»
val float y Ͱ 20.25»

val bool activo Ͱ true»

val char letra Ͱ 'A'»

val string nombre Ͱ "Alice"»


| ============================================================
| FUNCIONES
| ============================================================

int sumar є: int a, int b :э ¿:

    return a + b»

:?


int multiplicar є: int a, int b :э ¿:

    return a * b»

:?


int calcular є: int a, int b, int c :э ¿:

    val int resultado Ͱ a + b * c»

    return resultado»

:?


void mostrar є: string texto :э ¿:

    print є: texto :э

:?


| ============================================================
| LLAMADAS NORMALES
| ============================================================

val int r1 Ͱ sumar є: 10, 20 :э»

val int r2 Ͱ multiplicar є: 5, 6 :э»

val int r3 Ͱ calcular є: 1, 2, 3 :э»


| ============================================================
| FUNCIONES DENTRO DE FUNCIONES
| ============================================================

val int r4 Ͱ sumar є:
    multiplicar є: 2, 3 :э,
    multiplicar є: 4, 5 :э
:э»


val int r5 Ͱ sumar є:
    sumar є: 1, 2 :э,
    sumar є: 3, 4 :э
:э»


val int r6 Ͱ sumar є:
    sumar є:
        sumar є: 1, 2 :э,
        sumar є: 3, 4 :э
    :э,
    5
:э»


| ============================================================
| PARENTESIS DENTRO DE PARENTESIS
| ============================================================

val int p1 Ͱ є: a + b :э»

val int p2 Ͱ є: є: a + b :э * c :э»

val int p3 Ͱ є:
    є:
        a + b
    :э * c
:э»


val int p4 Ͱ є:
    є:
        є:
            a + b
        :э * c
    :э + 10
:э»


| ============================================================
| EXPRESIONES MUY PROFUNDAS
| ============================================================

val int profunda1 Ͱ є:
    є:
        є:
            a + b
        :э * c
    :э - 5
:э»


val int profunda2 Ͱ є:
    є:
        sumar є: a, b :э
        +
        multiplicar є: b, c :э
    :э * 2
:э»


val int profunda3 Ͱ є:
    sumar є:
        є: a + b :э,
        multiplicar є:
            є: c * 2 :э,
            5
        :э
    :э
:э»


| ============================================================
| POTENCIAS COMPLEJAS
| ============================================================

val int pot1 Ͱ 2 pot 3»

val int pot2 Ͱ 2 pot є: 3 + 2 :э»

val int pot3 Ͱ 2 pot є: 3 pot 2 :э»

val int pot4 Ͱ є: 2 pot 3 :э + є: 4 pot 2 :э»

val int pot5 Ͱ є:
    є: 2 pot 3 :э
    +
    є: 4 pot є: 2 + 1 :э :э
:э»


| ============================================================
| CONDICIONES COMPLEJAS
| ============================================================

void probarCondiciones є: :э ¿:


    if є: a > 0 :э ¿:

        print є: "A" :э

    :?


    if є: a > 0 λ b > 0 :э ¿:

        print є: "AND" :э

    :?


    if є: a > 100 θ b > 0 :э ¿:

        print є: "OR" :э

    :?


    if Σ є: a < 0 :э :э ¿:

        print є: "NOT" :э

    :?


    if є: a > 0 λ b > 0 θ c > 0 :э ¿:

        print є: "Compleja" :э

    :?


    | --------------------------------------------------------
    | IF ANIDADO
    | --------------------------------------------------------

    if є: a > 0 :э ¿:

        if є: b > 0 :э ¿:

            if є: c > 0 :э ¿:

                print є: "Tres niveles" :э

            :?

        :?

    :?


:? 


| ============================================================
| WHILE DENTRO DE IF
| ============================================================

void estructuras є: :э ¿:

    val int contador Ͱ 10»

    if є: contador > 0 :э ¿:

        while є: contador > 0 :э ¿:

            if є: contador mod 2 == 0 :э ¿:

                print є: "Par" :э

            :? else ¿:

                print є: "Impar" :э

            :?

            contador Ͱ contador - 1»

        :?

    :?


    | --------------------------------------------------------
    | FOR DENTRO DE WHILE
    | --------------------------------------------------------

    while є: contador < 20 :э ¿:

        for є: i Ͱ 0» i < 5» i++ :э ¿:

            print є: i :э

        :?

        contador Ͱ contador + 1»

    :?

:? 


| ============================================================
| PRINCIPAL
| ============================================================

void principal є: :э ¿:


    val int numero1 Ͱ 10»
    val int numero2 Ͱ 20»
    val int numero3 Ͱ 30»


    | ========================================================
    | ERROR 1
    | FALTA TERMINADOR
    | ========================================================

    val int error1 Ͱ 100


    | ========================================================
    | CONTINUACION
    | ========================================================

    val int despues1 Ͱ 200»

    print є: despues1 :э


    | ========================================================
    | ERROR 2
    | EXPRESION INCOMPLETA
    | ========================================================

    val int error2 Ͱ»


    | ========================================================
    | CONTINUACION
    | ========================================================

    val int despues2 Ͱ 300»


    | ========================================================
    | ERROR 3
    | DOS OPERADORES
    | ========================================================

    val int error3 Ͱ numero1 + * numero2»


    | ========================================================
    | CONTINUACION
    | ========================================================

    val int despues3 Ͱ 400»


    | ========================================================
    | ERROR 4
    | PARENTESIS DE MAS
    | ========================================================

    val int error4 Ͱ є: numero1 + numero2 :э :э»


    | ========================================================
    | CONTINUACION
    | ========================================================

    val int despues4 Ͱ 500»


    | ========================================================
    | ERROR 5
    | PARENTESIS SIN CIERRE
    | ========================================================

    val int error5 Ͱ є: numero1 + numero2»


    | ========================================================
    | CONTINUACION
    | ========================================================

    val int despues5 Ͱ 600»


    | ========================================================
    | ERROR 6
    | FUNCION SIN CIERRE DE PARAMETROS
    | ========================================================

    val int error6 Ͱ sumar є: numero1, numero2»


    | ========================================================
    | CONTINUACION
    | ========================================================

    val int despues6 Ͱ 700»


    | ========================================================
    | ERROR 7
    | COMA EXTRA
    | ========================================================

    val int error7 Ͱ sumar є: numero1,, numero2 :э»


    | ========================================================
    | CONTINUACION
    | ========================================================

    val int despues7 Ͱ 800»


    | ========================================================
    | ERROR 8
    | ARGUMENTO FALTANTE
    | ========================================================

    val int error8 Ͱ sumar є: numero1, :э»


    | ========================================================
    | CONTINUACION
    | ========================================================

    val int despues8 Ͱ 900»


    | ========================================================
    | ERROR 9
    | OPERADOR RELACIONAL SIN SEGUNDO OPERANDO
    | ========================================================

    if є: numero1 > :э ¿:

        print є: "Error" :э

    :?


    | ========================================================
    | CONTINUACION
    | ========================================================

    val int despues9 Ͱ 1000»


    | ========================================================
    | ERROR 10
    | IF SIN CONDICION
    | ========================================================

    if є: :э ¿:

        print є: "Error" :э

    :?


    | ========================================================
    | CONTINUACION
    | ========================================================

    val int despues10 Ͱ 1100»


    | ========================================================
    | ERROR 11
    | ELSE SIN IF
    | ========================================================

    else ¿:

        print є: "Else huerfano" :э

    :?


    | ========================================================
    | CONTINUACION
    | ========================================================

    val int despues11 Ͱ 1200»


    | ========================================================
    | ERROR 12
    | ELIF SIN IF
    | ========================================================

    elif є: numero1 > 0 :э ¿:

        print є: "Elif huerfano" :э

    :?


    | ========================================================
    | CONTINUACION
    | ========================================================

    val int despues12 Ͱ 1300»


    | ========================================================
    | ERROR 13
    | ELSE MAL FORMADO
    | ========================================================

    if є: numero1 > 0 :э ¿:

        print є: "Correcto" :э

    :? else

        print є: "Incorrecto" :э

    :?


    | ========================================================
    | CONTINUACION
    | ========================================================

    val int despues13 Ͱ 1400»


    | ========================================================
    | ERROR 14
    | WHILE SIN CONDICION
    | ========================================================

    while є: :э ¿:

        print є: "Error" :э

    :?


    | ========================================================
    | CONTINUACION
    | ========================================================

    val int despues14 Ͱ 1500»


    | ========================================================
    | ERROR 15
    | WHILE SIN CIERRE
    | ========================================================

    while є: numero1 > 0 :э ¿:

        print є: numero1 :э


    | ========================================================
    | CONTINUACION
    | ========================================================

    val int despues15 Ͱ 1600»


    | ========================================================
    | ERROR 16
    | FOR INCOMPLETO
    | ========================================================

    for є: i Ͱ 0» i < 10» :э ¿:

        print є: i :э

    :?


    | ========================================================
    | CONTINUACION
    | ========================================================

    val int despues16 Ͱ 1700»



    | ========================================================
    | CONTINUACION
    | ========================================================

    val int despues17 Ͱ 1800»


    | ========================================================
    | ERROR 18
    | RETURN SIN VALOR
    | ========================================================

    return»


    | ========================================================
    | CONTINUACION
    | ========================================================

    val int despues18 Ͱ 1900»


    | ========================================================
    | ERROR 19
    | MULTIPLES OPERADORES
    | ========================================================

    val int error19 Ͱ numero1 + - * / numero2»


    | ========================================================
    | CONTINUACION
    | ========================================================

    val int despues19 Ͱ 2000»


    | ========================================================
    | ERROR 20
    | BLOQUE EXTRA
    | ========================================================

    ¿:

        print є: "Bloque extra" :э

    :?


    | ========================================================
    | CONTINUACION FINAL
    | ========================================================

    val int final1 Ͱ 999»

    val int final2 Ͱ є:
        sumar є:
            multiplicar є: 2, 3 :э,
            sumar є: 4, 5 :э
        :э
        +
        є:
            10 + 20
        :э
    :э»


    print є: final1 :э

    print є: final2 :э

:? 